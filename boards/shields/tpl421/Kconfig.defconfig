## boards/shields/tpl421/Kconfig.defconfig
```kconfig
if SHIELD_TPL412

# Name must be less than 16 characters long!
config ZMK_KEYBOARD_NAME
    default "tpl412"

endif
```

## boards/shields/tpl421/Kconfig.shield
```kconfig
# No whitespace after the comma or in your keyboard name!
config SHIELD_TPL412
    def_bool $(shields_list_contains,tpl412)
```

## boards/shields/tpl_412/Kconfig.defconfig
```kconfig
if SHIELD_TP_L412

# Name must be less than 16 characters long!
config ZMK_KEYBOARD_NAME
    default "TP L412"

config SPI
	default y

endif
```

## boards/shields/tpl_412/Kconfig.shield
```kconfig
# No whitespace after the comma or in your keyboard name!
config SHIELD_TP_L412
    def_bool $(shields_list_contains,tp_l412)
```
